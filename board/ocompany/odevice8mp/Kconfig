## board/ocompany/odevice8mp/Kconfig
```kconfig
if TARGET_ODEVICE8MP

config SYS_BOARD
	default "odevice8mp"

config SYS_VENDOR
	default "ocompany"

config SYS_CONFIG_NAME
	default "odevice8mp"

source "board/ocompany/common/Kconfig"

endif
```
